/dts-v1/;
/plugin/;


/{
    compatible = "radxa,rock3a","rockchip,rk3568";
    fragment@0 {
	target = <&spi3>;
	__overlay__ {
	    status = "okay";
	    #address-cells = <1>;
	    #size-cells = <0>;
	    pinctrl-names = "default";
	    pinctrl-0=<&spi3m1_pins &spi3m1_cs0>;
	    flash: flash@0 {
		compatible = "rohm,dh2228fv";
		reg = <0>;
		spi-max-frequency = <50000000>;
	    };
	};
    };
};
